## board/Kconfig
```kconfig
config GENERIC_GX
	bool "Support Generic gxl board"
	default n

config GENERIC_G12B
	bool "Support Generic g12b board"
	default n

config KHADAS_COMMON
	bool
	default n

config KHADAS_VIM1
	bool "Support Khadas VIM1 board"
	select KHADAS_COMMON
	default n

config KHADAS_VIM3
	bool "Support Khadas VIM3 board"
	select KHADAS_COMMON
	default n

if GENERIC_GX
source "board/generic/gxl/Kconfig"
endif

if GENERIC_G12B
source "board/generic/g12b/Kconfig"
endif

if KHADAS_VIM1
source "board/khadas/kvim1/Kconfig"
endif

if KHADAS_VIM3
source "board/khadas/kvim3/Kconfig"
endif
```

## board/generic/g12a/Kconfig
```kconfig
if TARGET_MESON_G12A

config SYS_CPU
	string
	default "armv8"

config SYS_BOARD
	string
	default "g12a"

config SYS_VENDOR
	string
	default "generic"

config SYS_SOC
	string
	default "g12a"

config SYS_CONFIG_NAME
	default "generic_g12a"

endif
```

## configs/Generic_28_defconfig
```kconfig
CONFIG_ARM=y
CONFIG_TARGET_MESON_G12A=y
CONFIG_GENERIC_G12A=y
CONFIG_DM=y
CONFIG_DM_GPIO=y
```
